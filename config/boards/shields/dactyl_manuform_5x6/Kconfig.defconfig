## config/boards/shields/dactyl_manuform_5x6/Kconfig.defconfig
```kconfig
if SHIELD_DACTYL_MANUFORM_5x6_DONGLE

  config ZMK_KEYBOARD_NAME
	  default "DM-5x6"

  config ZMK_SPLIT_ROLE_CENTRAL
	  default y

endif


if SHIELD_DACTYL_MANUFORM_5x6_LEFT || SHIELD_DACTYL_MANUFORM_5x6_RIGHT || SHIELD_DACTYL_MANUFORM_5x6_DONGLE

  config ZMK_SPLIT
    default y

endif
```
